## Kconfig
```kconfig
# SPDX-License-Identifier: MIT

menuconfig ZMK_FEATURE_BRAILLE
    bool "Braille input module"
    default n
    depends on !ZMK_SPLIT || ZMK_SPLIT_ROLE_CENTRAL
    help
      Build the out-of-tree Braille behavior module on the split central
      or a non-split keyboard. Braille dot/space behaviors route input by
      binding parameter on any layer, without an on/off state. Chords collect
      all nine Braille bits until the last release, without a timer. The mode
      key composes ZMK hold-tap/layer behaviors; settings hooks suspend Braille
      typing until exit. The shared engine matches the selected mode's tables
      and dispatches host keystrokes; the ueb1 table carries contextual UEB
      Grade 1 (numeric, capitalisation and Grade 1 indicators, word context
      and the US keyboard's printable signs). Optional Grade 2, persistent
      overrides, and a display-based settings editor extend these modes.

if ZMK_FEATURE_BRAILLE

config ZMK_BRAILLE_GRADE2
    bool "Optional UEB Grade 2 rules"
    default n
    help
      Include contracted UEB reading, Grade 1 fallback and bounded 32-cell
      word buffering. The initial modes work without it.

config ZMK_BRAILLE_COMPUTER8_SHORT
    bool "Optional Computer8 with automatic shorthand"
    depends on ZMK_BRAILLE_GRADE2
    default n
    help
      Add computer8_short: Computer8 characters and commands with automatic
      75 shortforms, 23 contextual alphabetic wordsigns and 32-cell word
      buffering. Other UEB2 contraction categories are excluded; see the
      phase-08 category policy.

config ZMK_BRAILLE_STORAGE
    bool "Persistent Braille modes and user overrides"
    default y if SETTINGS
    depends on SETTINGS
    select ZMK_BEHAVIOR_METADATA
    help
      Store up to 256 overrides with stable behavior names and restore the
      selected character mode. Flash capacity still limits total saved data.
      Invalid records remain stored and are reported for recovery.

config ZMK_BRAILLE_STORAGE_POOL_SIZE
    int "RAM bytes for compact override actions"
    depends on ZMK_BRAILLE_STORAGE
    default 16384
    range 4096 32768
    help
      Allows 256 small overrides without reserving 16 actions for every rule.
      Saving fails visibly when the byte pool or flash capacity is exhausted.

config ZMK_BRAILLE_SETTINGS_UI
    bool "On-device Braille settings editor"
    depends on ZMK_BRAILLE_STORAGE
    select ZMK_BEHAVIOR_METADATA
    default n
    help
      Edit persistent bindings through Braille chords without sending search
      or capture input to the host. A display renderer must show the snapshot.

config ZMK_BRAILLE_SEARCH_RESULTS
    int "Maximum settings search results"
    depends on ZMK_BRAILLE_SETTINGS_UI
    default 16
    range 4 32

config ZMK_BRAILLE_WIDGET
    bool "Small-display Braille overlay"
    depends on ZMK_BRAILLE_SETTINGS_UI && ZMK_DISPLAY
    select LV_USE_LABEL
    select LV_FONT_UNSCII_8
    default n
    help
      Show the editor and pending/held input on a central display. The keyboard
      must call braille_widget_init after creating its status screen.

config ZMK_BRAILLE_WIDGET_LAYER
    int "Layer showing the Braille overlay"
    depends on ZMK_BRAILLE_WIDGET
    default 0
    range 0 31

endif # ZMK_FEATURE_BRAILLE
```

## dts/bindings/behaviors/zmk,behavior-braille-dot.yaml
```yaml
# SPDX-License-Identifier: MIT

description: |
  Braille dot input. The parameter is a dot number from 1 through 8, not a
  bitmask. Chords end when all Braille keys are released; there is no timeout.

compatible: "zmk,behavior-braille-dot"

include: one_param.yaml
```

## dts/bindings/behaviors/zmk,behavior-braille-mode.yaml
```yaml
# SPDX-License-Identifier: MIT

description: |
  Braille mode key. The parameter is the target keymap layer: hold keeps it
  active while chording, and tap switches to it. This is a layer selector,
  not a character-table selector.

compatible: "zmk,behavior-braille-mode"

include: one_param.yaml
```

## dts/bindings/behaviors/zmk,behavior-braille-select.yaml
```yaml
# SPDX-License-Identifier: MIT

description: |
  Select the Braille character mode, independently of keyboard layers.
  Parameters from dt-bindings/zmk/braille.h select UEB1, Computer8, optional
  UEB2, or the next compiled mode. Selection discards pending and held input.

compatible: "zmk,behavior-braille-select"
include: one_param.yaml
```

## dts/bindings/behaviors/zmk,behavior-braille-settings.yaml
```yaml
# SPDX-License-Identifier: MIT

description: |
  Enter the on-device Braille settings interface. A zero-parameter ZMK behavior
  action, usable from a keymap or the shared rule action list.

compatible: "zmk,behavior-braille-settings"

include: zero_param.yaml
```

## dts/bindings/behaviors/zmk,behavior-braille-space.yaml
```yaml
# SPDX-License-Identifier: MIT

description: |
  Braille space input, the ninth chord bit, distinct from conventional space.
  Chords end when all Braille keys are released; there is no timeout.

compatible: "zmk,behavior-braille-space"

include: zero_param.yaml
```

## dts/bindings/zmk,braille.yaml
```yaml
# SPDX-License-Identifier: MIT

description: Per-keyboard Braille input configuration

compatible: "zmk,braille"

properties:
  factory-behaviors:
    type: phandles
    description: |
      Retains the key-press and sticky-key behavior devices used by compiled
      factory rules, even if the keymap has no direct kp or sk binding.
      Supplied by behaviors/braille.dtsi; not a runtime action configuration.
  default-mode:
    type: string
    default: "ueb1"
    description: |
      Stable name of the default character table. Used when no selected mode
      is saved or the saved mode is not compiled in. Names are extensible,
      not an enum; this setting must name a table compiled into the firmware.
      Table availability and persisted-mode selection are runtime concerns.
```

## tests/firmware/commands/dts/bindings/braille,test-commands.yaml
```yaml
# SPDX-License-Identifier: MIT
description: Native factory-command assertion checkpoint
compatible: "braille,test-commands"
include: one_param.yaml
```

## tests/firmware/mode-settings/dts/bindings/braille,test-check.yaml
```yaml
# SPDX-License-Identifier: MIT
description: Test-only assertion checkpoint
compatible: "braille,test-check"
include: one_param.yaml
```

## tests/firmware/mode-settings/dts/bindings/braille,test-entry.yaml
```yaml
# SPDX-License-Identifier: MIT
description: Test-only entry into the settings routing gate
compatible: "braille,test-entry"
include: zero_param.yaml
```

## tests/firmware/mode-settings/dts/bindings/braille,test-exit.yaml
```yaml
# SPDX-License-Identifier: MIT
description: Test-only settings exit hook
compatible: "braille,test-exit"
include: zero_param.yaml
```
